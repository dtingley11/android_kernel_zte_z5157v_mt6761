## KernelSU-Next/kernel/Kconfig
```kconfig
menu "KernelSU"

config KSU
	bool "KernelSU Next support"
	depends on OVERLAY_FS && SECURITY_SELINUX && KEYS
	depends on ARM || ARM64 || X86_64
	depends on EXT4_FS = y && CRYPTO
	select CRYPTO_SHA256
	default n
	help
	  Enable kernel-level root privileges on Android System.
	  Built into the kernel using source and LSM hooks.

config KSU_MANUAL_HOOK
	bool
	depends on KSU
	default y
	help
	  Use the source hooks integrated in this kernel tree.

config KSU_KPROBES_HOOK
	bool
	depends on KSU
	depends on KPROBES && !KSU_MANUAL_HOOK
	depends on ARM64 || X86_64
	default n
	help
	  Disable if you use manual hooks.

config KSU_DEBUG
	bool "KernelSU debug mode"
	depends on KSU
	default n
	help
	  Enable KernelSU debug mode.

config KSU_ALLOWLIST_WORKAROUND
        bool "KernelSU Session Keyring Init workaround"
        depends on KSU
        default n
        help
          Enable session keyring init workaround for problematic devices.
          Useful for situations where the SU allowlist is not kept after a reboot.

config KSU_LSM_SECURITY_HOOKS
	bool
	depends on KSU
	default y

endmenu
```
